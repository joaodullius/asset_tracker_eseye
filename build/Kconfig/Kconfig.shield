## build/Kconfig/Kconfig.shield
```kconfig
osource "C:/Work/nrf/v1.5.1/nrf/boards/shields/*/Kconfig.shield"
osource "C:/Work/nrf/v1.5.1/zephyr/boards/shields/*/Kconfig.shield"
osource "C:/Work/nrf/v1.5.1/zephyr/boards/shields/*/Kconfig.shield"
```
